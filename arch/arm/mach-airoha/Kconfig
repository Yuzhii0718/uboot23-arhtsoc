## configs/an7581_tpl_enc_evb_defconfig
```kconfig
CONFIG_ARM=y
# CONFIG_SYS_HAS_NONCACHED_MEMORY is not set
CONFIG_SYS_ARCH_TIMER=y
CONFIG_SYS_THUMB_BUILD=y
CONFIG_ARCH_AIROHA=y
CONFIG_UBOOT_ARHT=y
CONFIG_TPL_UBOOT_ARHT=y
CONFIG_TEXT_BASE=0x81E00000
CONFIG_SYS_MALLOC_F_LEN=0x4000
CONFIG_NR_DRAM_BANKS=1
CONFIG_DEFAULT_DEVICE_TREE="an7581-evb"
CONFIG_SPL_TEXT_BASE=0x91E00000
#CONFIG_TPL_TEXT_BASE=0x1f001000
CONFIG_TPL_TEXT_BASE=0x8a901000
CONFIG_SYS_PROMPT="U-Boot> "
CONFIG_TARGET_AN7581=y
CONFIG_TARGET_AN7581_RDKF=y
CONFIG_TPL_LIBGENERIC_SUPPORT=y
CONFIG_SPL_LIBGENERIC_SUPPORT=y
CONFIG_SPL_DRIVERS_MISC=y
CONFIG_SPL_STACK_R_ADDR=0x90000000
CONFIG_TPL_SYS_MALLOC_F_LEN=0x4000
CONFIG_SYS_LOAD_ADDR=0x81800000
CONFIG_SPL_PAYLOAD="u-boot-lzma.img"
CONFIG_BUILD_TARGET="u-boot.bin"
#CONFIG_HAS_CUSTOM_SYS_INIT_SP_ADDR=y
#CONFIG_CUSTOM_SYS_INIT_SP_ADDR=0x81000000
CONFIG_SPL_IMAGE="spl/u-boot-spl-mtk.bin"
CONFIG_FIT=y
CONFIG_FIT_SIGNATURE=y
CONFIG_FIT_RSASSA_PSS=y
CONFIG_RSA_SOFTWARE_EXP=y
CONFIG_TPL_FIT_SIGNATURE=y
CONFIG_TPL_CRYPTO=y
CONFIG_TPL_ENC=y
CONFIG_ARHT_MBEDTPLS_CIPHER=y
CONFIG_CMD_AES=y
CONFIG_TPL_HASH=y
CONFIG_TPL_SHA1=y
CONFIG_TPL_SHA256=y
CONFIG_TPL_SHA512=y
CONFIG_SHA1=y
CONFIG_SHA256=y
CONFIG_SHA512=y
CONFIG_TPL_RSA=y
CONFIG_TPL_RSA_VERIFY=y
CONFIG_TPL_IMAGE_SIGN_INFO=y
CONFIG_TPL_FIT_RSASSA_PSS=y
CONFIG_FIT_VERBOSE=y
CONFIG_BOOTDELAY=3
CONFIG_DEFAULT_FDT_FILE="an7581-evb"
CONFIG_SYS_CONSOLE_IS_IN_ENV=y
# CONFIG_DISPLAY_BOARDINFO is not set
CONFIG_SPL_MAX_SIZE=0x10000
CONFIG_SPL_FOOTPRINT_LIMIT=y
CONFIG_SPL_MAX_FOOTPRINT=0x10000
CONFIG_SPL_SYS_MALLOC_SIMPLE=y
# CONFIG_SPL_SHARES_INIT_SP_ADDR is not set
CONFIG_SPL_STACK=0x1e810000
CONFIG_SPL_STACK_R=y
#CONFIG_SPL_NOR_SUPPORT=y
#CONFIG_SPL_WATCHDOG=y
CONFIG_HUSH_PARSER=y
CONFIG_SYS_MAXARGS=8
CONFIG_SYS_PBSIZE=1049
CONFIG_SYS_BOOTM_LEN=0x4000000
CONFIG_CMD_BOOTMENU=y
# CONFIG_CMD_ELF is not set
# CONFIG_CMD_XIMG is not set
CONFIG_CMD_BIND=y
# CONFIG_CMD_FLASH is not set
CONFIG_CMD_GPIO=y
CONFIG_CMD_SF_TEST=y
CONFIG_CMD_USB=y
# CONFIG_CMD_SETEXPR is not set
# CONFIG_CMD_NFS is not set
CONFIG_CMD_PING=y
CONFIG_CMD_FAT=y
CONFIG_CMD_FS_GENERIC=y
CONFIG_CMD_LOG=y
CONFIG_CMD_SAVEENV=y
CONFIG_OF_SPL_REMOVE_PROPS="pinctrl-0 pinctrl-names clock-names interrupt-parent assigned-clocks assigned-clock-parents"
CONFIG_ENV_OVERWRITE=y
CONFIG_SYS_RELOC_GD_ENV_ADDR=y
CONFIG_NET_RANDOM_ETHADDR=y
#CONFIG_SPL_DM_SEQ_ALIAS=y
CONFIG_REGMAP=y
CONFIG_SPL_REGMAP=y
CONFIG_SYSCON=y
CONFIG_SPL_SYSCON=y
CONFIG_CLK=y
CONFIG_SPL_CLK=y
CONFIG_MTD=y
CONFIG_TPL_DM=y
CONFIG_TPL_OF_LIBFDT=y
CONFIG_DM_MTD=y
CONFIG_MTD_SPI_NAND=y
CONFIG_SPI_FLASH_MTD=y
CONFIG_DM_SPI_FLASH=y
CONFIG_SPI_FLASH_EON=y
CONFIG_SPI_FLASH_GIGADEVICE=y
CONFIG_SPI_FLASH_ISSI=y
CONFIG_SPI_FLASH_MACRONIX=y
CONFIG_SPI_FLASH_SPANSION=y
CONFIG_SPI_FLASH_STMICRO=y
CONFIG_SPI_FLASH_WINBOND=y
CONFIG_MMC_HS200_SUPPORT=y
CONFIG_MMC_AIROHA=y
CONFIG_MMC_WRITE=y
CONFIG_BLOCK_CACHE=y
# CONFIG_MEDIATEK_ETH is not set
CONFIG_PHY=y
#CONFIG_PHY_MTK_TPHY=y
CONFIG_PINCTRL=y
CONFIG_PINCONF=y
CONFIG_PINCTRL_MT7629=y
CONFIG_POWER_DOMAIN=y
#CONFIG_MTK_POWER_DOMAIN=y
CONFIG_DM_REGULATOR=y
CONFIG_DM_REGULATOR_FIXED=y
CONFIG_RAM=y
CONFIG_SPL_RAM=y
CONFIG_DM_SERIAL=y
CONFIG_TPL_SERIAL=y
CONFIG_TPL_RAM=y
CONFIG_ARHT_SERIAL=y
# CONFIG_MTK_SERIAL is not set
CONFIG_SPI=y
CONFIG_DM_SPI=y
CONFIG_TPL_SPI=y
# CONFIG_MTK_SNOR=y
#CONFIG_SYSRESET=y
#CONFIG_SPL_SYSRESET=y
#CONFIG_SYSRESET_WATCHDOG=y
#CONFIG_USB=y
#CONFIG_USB_XHCI_HCD=y
#CONFIG_USB_XHCI_MTK=y
#CONFIG_USB_STORAGE=y
#CONFIG_USB_KEYBOARD=y
#CONFIG_WDT_MTK=y
CONFIG_LZMA=y
CONFIG_SPL_LZMA=y
# CONFIG_EFI_LOADER is not set
CONFIG_CMD_SPI=y
CONFIG_ENV_IS_IN_SNAND_FLASH=y
CONFIG_ENV_IS_IN_MMC=y
CONFIG_ENV_OFFSET=0x7c000
CONFIG_SYS_SNAND_ENV_DEV="bootloader"
CONFIG_SYS_MMC_ENV_DEV="bootloader"
CONFIG_ENV_SIZE=0x4000
CONFIG_ENV_SECT_SIZE=0x20000
CONFIG_ENV_VARS_UBOOT_RUNTIME_CONFIG=y
CONFIG_CMD_MTD=y
CONFIG_CMD_MTDPARTS=y
CONFIG_DMA=y
CONFIG_AIROHA_ETH=y
CONFIG_ARHT_SPI=y
CONFIG_CMD_BOOTZ=y
CONFIG_SUPPORT_TPL=y
CONFIG_SPL=y
CONFIG_TPL=y
CONFIG_TPL_FRAMEWORK=y
CONFIG_TPL_TINY_MEMSET=y
CONFIG_TPL_MAX_SIZE=0x20000
CONFIG_SPL_MTD_SUPPORT=y
CONFIG_TPL_EFI_PARTITION=y
CONFIG_SUPPORT_SPL=y
CONFIG_TPL_LOAD_FIT=y
CONFIG_TPL_SERIAL=y
CONFIG_TPL_ATF=y
CONFIG_TPL_OF_LIBFDT=y
CONFIG_TPL_FIT=y
CONFIG_TPL_LIBCOMMON_SUPPORT=y
CONFIG_TPL_LIBGENERIC_SUPPORT=y
CONFIG_TPL_OF_REAL=y
CONFIG_TPL_OF_CONTROL=y
CONFIG_TPL_DM_SPI=y
CONFIG_TPL_DM_SPI_FLASH=y
CONFIG_TPL_DM_STDIO=y
CONFIG_TPL_MMC=y
CONFIG_TPL_SPI_LOAD=y
CONFIG_TPL_SPI_FLASH_SUPPORT=y
CONFIG_TPL_SPI_FLASH_MTD=y
CONFIG_CMD_MMC=y
CONFIG_CMD_EXT4=y
CONFIG_CMD_GPT=y
CONFIG_CMD_GPT_RENAME=y
CONFIG_PARTITION_TYPE_GUID=y
CONFIG_OF_LIBFDT=y
CONFIG_DM_LED=y
CONFIG_LED=y
CONFIG_LED_GPIO=y
CONFIG_TPL_MMC_WRITE=y
CONFIG_TPL_BLK=y
CONFIG_TPL_FIT_PRINT=y
# CONFIG_TPL_ENV_SUPPORT is not set
# CONFIG_TPL_ENV_IS_IN_MMC is not set
# CONFIG_TPL_SPRINTF is not set
# CONFIG_TPL_CMD_GPT is not set
CONFIG_SYS_MMCSD_RAW_MODE_U_BOOT_USE_PARTITION=y
CONFIG_SYS_MMCSD_RAW_MODE_U_BOOT_PARTITION=0x2
CONFIG_TPL_SYS_MALLOC_SIMPLE=y
CONFIG_SPL_LIBCOMMON_SUPPORT=y
CONFIG_TPL_CRC32=y
CONFIG_SYS_MMCSD_RAW_MODE_U_BOOT_USE_SECTOR=y
CONFIG_SYS_MMCSD_RAW_MODE_U_BOOT_SECTOR=0x420
CONFIG_SYS_SPI_U_BOOT_OFFS=0x80000
CONFIG_SPL_STACK_R_MALLOC_SIMPLE_LEN=0x400000
CONFIG_TPL_ATF_NO_PLATFORM_PARAM=y
CONFIG_ARHT_GPIO=y
CONFIG_DM_GPIO=y
CONFIG_CMD_GPIO=y
#CONFIG_SPL_GPIO=y
#CONFIG_BOARD_LATE_INIT=y
```

## drivers/mtd/nand/Kconfig
```kconfig
config MTD_NAND_CORE
	tristate

config AIROHA_BMT
	bool "Airoha BMT"
	depends on MTD_NAND_CORE
	default y
	help
	  Airoha BMT is a bad block management tool for NAND flash.

source "drivers/mtd/nand/raw/Kconfig"

source "drivers/mtd/nand/spi/Kconfig"
```
