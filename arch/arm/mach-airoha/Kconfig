## arch/arm/mach-airoha/Kconfig
```kconfig
if ARCH_AIROHA

config SYS_SOC
	default "airoha"

config SYS_VENDOR
	default "airoha"

choice
	prompt "Airoha board select"

config TARGET_AN7552
	bool "Airoha AN7552 SoC"
	select CPU_V7A
	help
	  The Airoha AN is a highly integrated XGGPON/XEEPON ARM-based SoC with a dual-core cpu
	  for broadband applications. It shares several logic units with EN7523
		
config TARGET_EN7523
	bool "Airoha EN7523 SoC"
	select CPU_V7A
	help
	  The Airoha EN7523 is a highly integrated GPON/EPON ARM-based SoC with a dual-core cpu
	  for broadband applications.  It comes with wifi 5/6 support and connectivity to Ethernet
		Phy,DDR,PCIe,USB,UART and Voip. With advanced hardware design, EN7523 provides high 
		processing performance and low power consumption

config TARGET_AN7581
	bool "Airoha AN7581 SoC"
	select ARM64
	help
	  The Airoha EN7581 is a ARM-based SoC with a quad-core Cortex-A7
	  including NEON and GPU, Mali-450 graphics, several DDR3 options,
	  crypto engine, built-in Wi-Fi / Bluetooth combo chip, JPEG decoder,
	  video interfaces supporting HDMI and MIPI, and video codec support.
	  Peripherals include Gigabit Ethernet, switch, USB3.0 and OTG, PCIe,
	  I2S, PCM, S/PDIF, UART, SPI, I2C, IR TX/RX, and PWM.


config TARGET_AN7583
	bool "Airoha AN7583 SoC"
	select ARM64
	help
	  The Airoha AN7583 is a ARM-based SoC with a dual-core Cortex-A7
	  including NEON and GPU, Mali-450 graphics, several DDR3 options,
	  crypto engine, built-in Wi-Fi / Bluetooth combo chip, JPEG decoder,
	  video interfaces supporting HDMI and MIPI, and video codec support.
	  Peripherals include Gigabit Ethernet, switch, USB3.0 and OTG, PCIe,
	  I2S, PCM, S/PDIF, UART, SPI, I2C, IR TX/RX, and PWM.

endchoice

config TARGET_AN7581_RDKF
	bool "Airoha AN7581 SoC for DT"
	select ARM64
	select SUPPORT_SPL
	select SUPPORT_TPL
	help
	  The Airoha EN7581 is a ARM-based SoC with a quad-core Cortex-A7
	  including NEON and GPU, Mali-450 graphics, several DDR3 options,
	  crypto engine, built-in Wi-Fi / Bluetooth combo chip, JPEG decoder,
	  video interfaces supporting HDMI and MIPI, and video codec support.
	  Peripherals include Gigabit Ethernet, switch, USB3.0 and OTG, PCIe,
	  I2S, PCM, S/PDIF, UART, SPI, I2C, IR TX/RX, and PWM.

config SYS_BOARD
	string "Board name"
	default "en7523" if TARGET_EN7523
	default "an7581" if TARGET_AN7581
	default "an7552" if TARGET_AN7552
	default "an7583" if TARGET_AN7583
	default ""
	help
	  This option contains information about board name.
	  Based on this option board/<CONFIG_SYS_VENDOR>/<CONFIG_SYS_BOARD> will
	  be used.
	  
config SYS_CONFIG_NAME
	string "Board configuration name"
	default "en7523" if TARGET_EN7523
	default "an7581" if TARGET_AN7581
	default "an7552" if TARGET_AN7552
	default "an7583" if TARGET_AN7583
	default ""
	help
	  This option contains information about board configuration name.
	  Based on this option include/configs/<CONFIG_SYS_CONFIG_NAME>.h header
	  will be used for board configuration.
		
config ARHT_BROM_HEADER_INFO
	string
	default "media=snand;nandinfo=2k+64" if TARGET_AN7581 || TARGET_EN7523 || TARGET_AN7552 || TARGET_AN7583

config UBOOT_ARHT
	bool "UBOOT_ARHT" 
	default "y"
	help
	  Uboot Airoha Config

config UIP_FWUPGRADE
	bool "uIP web firmware recovery mode"
	depends on CMD_NET
	select OPEN_IMAGE
	default y
	help
	  Build the uIP based web recovery server into U-Boot.  It answers on
	  the fixed address 192.168.1.1 and lets a browser upload a firmware
	  image.

	  The mode is entered either manually with the 'httpd' command or
	  automatically when the board's reset key (GPIO 0, active low) is
	  held down during the autoboot delay.

config OPEN_IMAGE
	bool "Airoha image / web upgrade support (OPEN_IMAGE)"
	help
	  Enable the image and upgrade support that the Airoha SDK selects with
	  CONFIG_OPEN_IMAGE:
	    - lib/bootlib.c: image write/verify library, button helper
	      (check_fw_gpio/up_file) and GPIO helpers
	    - uip/apps/webserver: the newer web upgrade flow (multipart upload,
	      /result.html, /reset, progress page)
	    - net/: ndisc.o and net6.o on AN7581 (see net/Makefile)
	    - the image/bootargs code selected by CONFIG_OPEN_IMAGE in
	      arch/arm/mach-airoha/

	  Leave it off if you only use the legacy upgrade paths.

choice
	prompt "Airoha image layout type"
	depends on OPEN_IMAGE
	default INCLUDE_MTD_TYPE_RAW2
	help
	  How the tclinux image area is laid out, i.e. where the misc, kernel and
	  rootfs parts live.  Selects INCLUDE_MTD_TYPE_RAW1 / RAW2 / FS in
	  include/bootlib.h.  RAW2 is what Airoha/TP-Link SPI-NAND boards use,
	  FS is for layouts whose kernel/rootfs are jffs2 files.

config INCLUDE_MTD_TYPE_RAW1
	bool "raw layout 1 (misc at the end of the image area)"

config INCLUDE_MTD_TYPE_RAW2
	bool "raw layout 2 (misc right after the bootloader)"

config INCLUDE_MTD_TYPE_FS
	bool "jffs2 filesystem layout (kernel/rootfs are files)"
endchoice

config MTD_BLOCK_SIZE
	hex "Flash erase block size (MTD_BLOCK_SIZE)"
	depends on OPEN_IMAGE
	default 0x20000
	help
	  Block size of the flash partitions.  For SPI-NAND this is the erase
	  block size (0x20000 = 128K).  Used as the misc partition block unit.

config MTD_IMAGE_SIZE
	hex "Size of the image area (MTD_IMAGE_SIZE)"
	depends on OPEN_IMAGE
	default 0x3500000
	help
	  Total size of bootloader + misc + kernel + rootfs.

config MTD_BOOT_SIZE
	hex "Size of the bootloader area (MTD_BOOT_SIZE)"
	depends on OPEN_IMAGE
	default 0x440000
	help
	  Size reserved for the bootloader (u-boot + its env) at the start of
	  the image area.

config MTD_KERNEL_SIZE
	hex "Size of the kernel partition (MTD_KERNEL_SIZE)"
	depends on OPEN_IMAGE
	default 0x580000

config MTD_MISC_SIZE
	hex "Size of the misc partition (MTD_MISC_SIZE)"
	depends on OPEN_IMAGE
	default 0x200000
	help
	  Size of the misc partition that holds per unit data (MAC, SN, pins).

config SYS_UBOOT_PARTITION_NAME
	string "partition name of uboot"
	default "bootloader"


config SYS_TCLINUX_PARTITION_NAME
	string "partition name of tclinux"
	default "tclinux"


config SYS_TCLINUX_SLAVE_PARTITION_NAME
	string "partition name of tclinux_slave"
	default "tclinux_slave"

config SYS_ART_PARTITION_NAME
	string "partition name of reserve area"
	default "art"

config TARGET_AN7552_TPL
	bool "Airoha AN7552 SoC for TPL option"
	select SUPPORT_SPL
	select SUPPORT_TPL
	help
	  Config for 7552 TPL.	
endif
```
