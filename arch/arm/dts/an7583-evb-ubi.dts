/dts-v1/;
#include "an7583.dtsi"
#include "airoha-aarch64-ubi-layout.dtsi"

/ {
    model = "AN7583 EVB(UBI layout)";
    compatible = "airoha,an7583", "airoha,an7583-evb";

	chosen { 
		bootargs = "console=ttyS0,115200 earlycon ubi.block=0,fit root=/dev/fit0 rootwait";
		stdout-path = &uart1;
	};
};
