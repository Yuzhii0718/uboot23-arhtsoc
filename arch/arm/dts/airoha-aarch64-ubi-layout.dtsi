&partitions {
    partition@0 {
        label = "bl2";
        reg = <0x00000000 0x00000000 0x00000000 0x000020000>; /* 128KB */
    };
    partition@20000 {
        label = "ubi";
        /* size 0 = MTDPART_SIZ_FULL: up to the end of the NAND device */
        reg = <0x00000000 0x00200000 0x00000000 0x00000000>;
    };
};
