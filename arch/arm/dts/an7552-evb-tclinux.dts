/dts-v1/;
#include "an7552.dtsi"
#include "airoha-armv7-tclinux-layout.dtsi"

/ {
    model = "AN7552 EVB(tclinux layout)";
    compatible = "airoha,an7552", "airoha,an7552-evb";

	chosen { 
		bootargs = "root=/dev/mtdblock3 ro console=ttyS0,115200n8 earlycon init=/sbin/init";
		stdout-path = &uart1;
	};
};
