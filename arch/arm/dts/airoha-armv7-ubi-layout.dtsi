&partitions {
    partition@0 {
        label = "u-boot";
        reg = <0x00000000 0x00100000>; /* 1MB */
    };
    partition@100000 {
        label = "ubi";
        compatible = "linux,ubi";
        /* size 0 = MTDPART_SIZ_FULL: up to the end of the NAND device */
        reg = <0x00100000 0x00000000>;
    };
};
