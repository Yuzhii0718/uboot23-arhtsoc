/dts-v1/;
#include "an7581.dtsi"
#include "airoha-aarch64-tclinux-layout.dtsi"

/ {
    model = "AN7581 EVB(tclinux layout)";
    compatible = "airoha,an7581", "airoha,an7581-evb";

	chosen { 
		bootargs = "root=/dev/mtdblock3 ro console=ttyS0,115200n8 earlycon init=/sbin/init";
		stdout-path = &uart1;
	};
};
