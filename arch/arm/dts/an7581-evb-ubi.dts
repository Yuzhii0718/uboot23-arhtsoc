/dts-v1/;
#include "an7581.dtsi"
#include "airoha-aarch64-ubi-layout.dtsi"

/ {
    model = "AN7581 EVB(UBI layout)";
    compatible = "airoha,an7581", "airoha,an7581-evb";

	chosen { 
		bootargs = "console=ttyS0,115200 earlycon ubi.block=0,fit root=/dev/fit0 rootwait";
		stdout-path = &uart1;
	};
};
